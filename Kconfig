## Kconfig
```kconfig
#
# For a description of the syntax of this configuration file,
# see Documentation/kbuild/kconfig-language.txt.
#
mainmenu "Linux/$ARCH $KERNELVERSION Kernel Configuration"

menu "FizzBuzz"

config FIZZBUZZ
	bool
	default n

config FIZZBUZZ_EMULATION
	bool "Enable FizzBuzz machine code emulation"
	select FIZZBUZZ
	---help---
	  fizzbuzz machine code wo emulation suru !

config BINFMT_FIZZBUZZ
	bool "Support for FizzBuzz executables"
	select FIZZBUZZ
	---help---
	  fizzbuzz executable wo support suru !

endmenu

config SRCARCH
	string
	option env="SRCARCH"

source "arch/$SRCARCH/Kconfig"
```
